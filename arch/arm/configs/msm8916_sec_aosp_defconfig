## fs/sdcardfs/Kconfig
```kconfig
config SDCARD_FS
	tristate "sdcard file system"
	default y
	help
	  Sdcardfs is based on Wrapfs file system.

config SDCARD_FS_FADV_NOACTIVE
	bool "sdcardfs fadvise noactive support"
	depends on FADV_NOACTIVE
	default y
	help
	  Sdcardfs supports fadvise noactive mode.

config SDCARD_FS_CI_SEARCH
	tristate "sdcardfs case-insensitive search support"
	depends on SDCARD_FS
	default y

config SDCARD_FS_SEC_API_L
	bool "sdcardfs for android api 22"
	depends on SDCARD_FS
	default n
	help
	  Sdcardfs2 driver for API 22 below

config SDCARD_FS_SEC_API_M
	bool "sdcardfs for android api 23"
	depends on SDCARD_FS
	default n
	help
	  Sdcardfs3 driver for API 23 and up

config SDCARD_FS_XATTR
	bool "Sdcardfs extended attribute"
	default y if CONFIG_SDCARD_FS_SEC_API_M=y
	default n if CONFIG_SDCARD_FS_SEC_API_L=y
	depends on SDCARD_FS
	help
	  Modification of sdcard file system for xattr
```
